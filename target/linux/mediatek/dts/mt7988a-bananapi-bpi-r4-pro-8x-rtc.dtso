// SPDX-License-Identifier: (GPL-2.0 OR MIT)
/*
 * RTC overlay for BPI-R4 Pro 8X (PCF8563)
 */

/dts-v1/;
/plugin/;

/ {
	compatible = "bananapi,bpi-r4-pro-8x", "mediatek,mt7988a";
};

&pcf8563 {
	status = "okay";
};
